## Documentation/devicetree/bindings/perf/brcm,bcm2835-axiperf.yaml
```yaml
# SPDX-License-Identifier: (GPL-2.0-only OR BSD-2-Clause)
%YAML 1.2
---
$id: http://devicetree.org/schemas/perf/brcm,bcm2835-axiperf.yaml#
$schema: http://devicetree.org/meta-schemas/core.yaml#

title: Broadcom BCM2835/2711/2712 AXI Performance Monitor

maintainers:
  - Ian Rogers <irogers@google.com>
  - Raspberry Pi Kernel Maintenance <kernel-list@raspberrypi.com>

description: |
  The Broadcom BCM2835 series (including BCM2711 and BCM2712) features hardware
  performance monitors on the AXI bus for evaluating memory bandwidth and
  system traffic. Depending on the SoC architecture, multiple monitors exist.
  The primary monitor evaluates the System fabric, while the secondary monitor
  evaluates the VideoCore VPU hardware.

  The VPU monitor is not accessible from the ARM, so it is accessed through
  the Raspberry Pi firmware mailbox using its VideoCore bus address.

properties:
  compatible:
    enum:
      - brcm,bcm2835-axiperf
      - brcm,bcm2711-axiperf
      - brcm,bcm2712-axiperf

  reg:
    items:
      - description: System monitor registers
      - description: VPU monitor registers, passed to the firmware mailbox

  firmware:
    $ref: /schemas/types.yaml#/definitions/phandle
    description: Phandle to the Raspberry Pi firmware node

required:
  - compatible
  - reg
  - firmware

additionalProperties: false

examples:
  - |
    pmu@7e009800 {
        compatible = "brcm,bcm2835-axiperf";
        reg = <0x7e009800 0x100>,
              <0x7ee08000 0x100>;
        firmware = <&firmware>;
    };
  - |
    pmu@7c012800 {
        compatible = "brcm,bcm2712-axiperf";
        reg = <0x7c012800 0x100>,
              <0x7ee00000 0x100>;
        firmware = <&firmware>;
    };
```
